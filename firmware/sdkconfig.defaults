## firmware/sdkconfig.defaults
```kconfig
CONFIG_ESP_MAIN_TASK_STACK_SIZE=32768

CONFIG_ESP_SYSTEM_EVENT_TASK_STACK_SIZE=4096
CONFIG_FREERTOS_IDLE_TASK_STACKSIZE=4096

CONFIG_PTHREAD_TASK_STACK_SIZE_DEFAULT=4096

CONFIG_HTTPD_MAX_REQ_HDR_LEN=1024

CONFIG_ESPTOOLPY_FLASHSIZE_4MB=y

CONFIG_LWIP_MAX_SOCKETS=16
```
